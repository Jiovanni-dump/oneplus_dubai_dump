/dts-v1/;

/ {

	fragment@0 {
		target = <0xffffffff>;

		__overlay__ {

			android {

				vbmeta {
					compatible = "android,vbmeta";
					parts = "vbmeta,boot,system,vendor,linux_rootfs_a,3rd_a,tvservice,factory_a";
					by_name_prefix = "/dev/block/platform/mstar_mci.0/by-name/vbmeta";
				};
			};
		};
	};

	fragment@1 {
		target = <0xffffffff>;

		__overlay__ {
			wifi-ctl-gpio = <0x1c>;
			wifi-ctl-invert = <0x01>;
			wifi-ctl-delayms = <0x64>;
			wifi-ctl-powerdown = <0x00>;
		};
	};

	__fixups__ {
		firmware = "/fragment@0:target:0";
		gpio_wifi_ctl = "/fragment@1:target:0";
	};
};
